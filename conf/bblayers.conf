## conf/bblayers.conf
```bitbake
# POKY_BBLAYERS_CONF_VERSION is increased each time build/conf/bblayers.conf
# changes incompatibly
POKY_BBLAYERS_CONF_VERSION = "2"

BBPATH = "${TOPDIR}"
BBFILES ?= ""

BBLAYERS ?= " \
  /home/mahmoud/Documents/YOCTO.BSP-ELCE2022/poky/meta \
  /home/mahmoud/Documents/YOCTO.BSP-ELCE2022/poky/meta-poky \
  /home/mahmoud/Documents/YOCTO.BSP-ELCE2022/poky/meta-yocto-bsp \
  "
```

## meta-elce2022-distro/conf/bblayers.conf.sample
```bitbake
POKY_BBLAYERS_CONF_VERSION = "2"

BBPATH = "${TOPDIR}"
BBFILES ?= ""

BBLAYERS ?= " \
  ##OEROOT##/../poky/meta \
  ##OEROOT##/../poky/meta-poky \
  ##OEROOT##/../poky/meta-yocto-bsp \
  ##OEROOT##/../meta-rauc \
  ##OEROOT##/../meta-wb15 \
  ##OEROOT##/../meta-ptx \
  ##OEROOT##/../meta-elce2022-distro \
  "
```

## meta-elce2022-distro/conf/distro/elce2022.conf
```bitbake
require conf/distro/poky.conf

DISTRO = "elce2022"
DISTRO_VERSION = "0.0.1"

DISTRO_FEATURES += "rauc"
```

## meta-elce2022-distro/conf/layer.conf
```bitbake
# We have a conf and classes directory, add to BBPATH
BBPATH .= ":${LAYERDIR}"

# We have recipes-* directories, add to BBFILES
BBFILES += "${LAYERDIR}/recipes-*/*/*.bb \
            ${LAYERDIR}/recipes-*/*/*.bbappend"

BBFILE_COLLECTIONS += "meta-elce2022-distro"
BBFILE_PATTERN_meta-elce2022-distro = "^${LAYERDIR}/"
BBFILE_PRIORITY_meta-elce2022-distro = "6"

LAYERDEPENDS_meta-elce2022-distro = "core"
LAYERSERIES_COMPAT_meta-elce2022-distro = "kirkstone"
```

## meta-wb15/conf/layer.conf
```bitbake
# We have a conf and classes directory, add to BBPATH
BBPATH .= ":${LAYERDIR}"

# We have recipes-* directories, add to BBFILES
BBFILES += "${LAYERDIR}/recipes-*/*/*.bb \
            ${LAYERDIR}/recipes-*/*/*.bbappend"

BBFILE_COLLECTIONS += "meta-wb15"
BBFILE_PATTERN_meta-wb15 = "^${LAYERDIR}/"
BBFILE_PRIORITY_meta-wb15 = "6"

LAYERDEPENDS_meta-wb15 = "core"
LAYERSERIES_COMPAT_meta-wb15 = "kirkstone"

# borrowed from meta-freescale
FSL_EULA_FILE = "${LAYERDIR}/FSL_EULA"
FSL_MIRROR ?= "https://www.nxp.com/lgfiles/NMG/MAD/YOCTO/"
```

## meta-wb15/conf/machine/wb15.conf
```bitbake
#@TYPE: Machine
#@NAME: NXP i.MX8M
#@DESCRIPTION: Machine configuration for i.MX8M SoCs

SOC_FAMILY = "mx8"
include conf/machine/include/soc-family.inc

DEFAULTTUNE = "cortexa53-crypto"
require conf/machine/include/arm/armv8a/tune-cortexa53.inc

MACHINEOVERRIDES .= ":mx8m"
MACHINE_FEATURES = "usbgadget usbhost vfat ext2 serial pci touchscreen"

MACHINE_EXTRA_RDEPENDS = " \
    kernel-modules \
    kernel-devicetree \
    linux-firmware-imx-sdma-imx7d \
"

MACHINE_SOCARCH = "${TUNE_PKGARCH}-mx8mm"
PACKAGE_EXTRA_ARCHS:append = " ${MACHINE_SOCARCH}"

EXTRA_IMAGEDEPENDS += "virtual/bootloader"
PREFERRED_PROVIDER_virtual/bootloader ?= "barebox"
BAREBOX_IMAGE = "barebox-innocomm-imx8mm-wb15-evk.img"

WKS_FILE_DEPENDS ?= " \
    virtual/bootloader \
    bmap-tools-native \
"

IMAGE_FSTYPES = "wic"
# Use templated kickstart file
WKS_FILE = "barebox-rootfs-sd.wks.in"

DDR_FIRMWARE_NAME = " \
	lpddr4_pmu_train_1d_imem.bin \
	lpddr4_pmu_train_1d_dmem.bin \
	lpddr4_pmu_train_2d_imem.bin \
	lpddr4_pmu_train_2d_dmem.bin \
"

PREFERRED_PROVIDER_virtual/kernel ?= "linux-wb15"
PREFERRED_PROVIDER_virtual/dtb ?= "devicetree"

KERNEL_IMAGETYPE = "Image.gz"
KERNEL_PACKAGE_NAME = "kernel"

BAD_RECOMMENDATIONS = "rng-tools"
```
